## app_samples/esp32c6_blinky/sample.yaml
```yaml
sample:
  name: ESP32-C6 blinky
  description: Minimal LED blink sample for esp32c6_devkitc using the local OOT module workspace
tests:
  sample.oot.esp32c6_blinky:
    build_only: true
    platform_allow:
      - esp32c6_devkitc/esp32c6/hpcore
    integration_platforms:
      - esp32c6_devkitc/esp32c6/hpcore
    tags:
      - gpio
      - esp32
```

## boards/surya/esp32c6_custom/Kconfig
```kconfig
# Copyright (c) 2026 Surya Poudel
# SPDX-License-Identifier: Apache-2.0

config HEAP_MEM_POOL_ADD_SIZE_BOARD
	int
	default 4096 if BOARD_ESP32C6_CUSTOM_ESP32C6_HPCORE
```

## boards/surya/esp32c6_custom/Kconfig.esp32c6_custom
```kconfig
# SPDX-License-Identifier: Apache-2.0

config BOARD_ESP32C6_CUSTOM
	select SOC_ESP32_C6_WROOM_1U_N4
	select SOC_ESP32C6_HPCORE if BOARD_ESP32C6_CUSTOM_ESP32C6_HPCORE
```

## boards/surya/esp32c6_custom/board.yml
```yaml
board:
  name: esp32c6_custom
  full_name: ESP32-C6 Custom
  vendor: surya
  socs:
    - name: esp32c6
```

## drivers/Kconfig
```kconfig
rsource "sh1106_drv/Kconfig"
rsource "nrf24_drv/Kconfig"
rsource "SD_drv/Kconfig"
rsource "tft_drv/Kconfig"
```

## drivers/SD_drv/Kconfig
```kconfig
# Copyright (c) 2023 Surya Poudel
# SPDX-License-Identifier: Apache-2.0

config SD_DRV
	bool "SD card driver on SPI bus"
	default n
	depends on DT_HAS_ZEPHYR_SDHC_SPI_SLOT_ENABLED
	depends on !SDHC
	select SPI
	help
	 Enable SD card driver.
```

## drivers/nrf24_drv/Kconfig
```kconfig
# Copyright (c) 2023 Surya Poudel
# SPDX-License-Identifier: Apache-2.0

config NRF24_DRV
	bool "NRF24 wireless module driver"
	default n
	depends on DT_HAS_NORDIC_NRF24_ENABLED
	select GPIO
	select SPI
	help
	 Enable NRF24 driver module.
```

## drivers/tft_drv/Kconfig
```kconfig
# Copyright (c) 2026 Surya Poudel
# SPDX-License-Identifier: Apache-2.0

config TFT_DRV
	bool "SPI TFT display driver"
	default n
	depends on DT_HAS_SURYA_TFT_SPI_ENABLED
	select SPI
	select GPIO
	help
	  Enable the Zephyr-style SPI TFT driver.
```

## dts/bindings/display/surya,tft-spi.yaml
```yaml
# Copyright (c) 2026 Surya Poudel
# SPDX-License-Identifier: Apache-2.0

description: SPI TFT controller binding owned by the Zephyr-OOT module.

compatible: "surya,tft-spi"

include: [ spi-device.yaml ]

properties:
  dc-gpios:
    type: phandle-array
    required: true
    description: Data/command select GPIO.

  reset-gpios:
    type: phandle-array
    required: false
    description: Optional hardware reset GPIO.

  width:
    type: int
    required: true
    description: Native panel width in pixels at rotation 0.

  height:
    type: int
    required: true
    description: Native panel height in pixels at rotation 0.

  rotation:
    type: int
    required: false
    default: 0
    enum:
      - 0
      - 1
      - 2
      - 3
    description: Initial rotation, in quarter turns clockwise.

  controller:
    type: string
    required: true
    enum:
      - "ili9341"
      - "st7789"
      - "st7796"
    description: TFT controller model used for MADCTL and inversion defaults.
```

## samples/esp32c6_blinky/sample.yaml
```yaml
sample:
  name: ESP32-C6 blinky
  description: Minimal LED blink sample for esp32c6_custom using the local OOT module workspace
tests:
  sample.oot.esp32c6_blinky:
    build_only: true
    platform_allow:
      - esp32c6_custom/esp32c6/hpcore
    integration_platforms:
      - esp32c6_custom/esp32c6/hpcore
    tags:
      - gpio
      - esp32
```

## subsys/Kconfig
```kconfig
# Copyright (c) 2023 Surya Poudel
# SPDX-License-Identifier: Apache-2.0

rsource "sh1106_gfx/Kconfig"
rsource "nrf24_ble/Kconfig"
rsource "sdFat32/Kconfig"
rsource "tft_gfx/Kconfig"
```

## subsys/sdFat32/Kconfig
```kconfig
# Copyright (c) 2023 Surya Poudel
# SPDX-License-Identifier: Apache-2.0

config SD_FAT32
	bool "FAT32 file system lib for SD card"
	default n
	depends on SD_DRV
	help
	 Enable the sdFat32 file system library.
```

## subsys/tft_gfx/Kconfig
```kconfig
# Copyright (c) 2026 Surya Poudel
# SPDX-License-Identifier: Apache-2.0

config TFT_GFX
	bool "TFT graphics subsystem"
	default n
	depends on TFT_DRV
	help
	  Enable the TFT graphics subsystem and font assets.
```
